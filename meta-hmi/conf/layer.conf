## meta-hmi/conf/layer.conf
```bitbake
# We have a conf and classes directory, add to BBPATH
BBPATH .= ":${LAYERDIR}"

# We have recipes-* directories, add to BBFILES
BBFILES += "${LAYERDIR}/recipes-*/*/*.bb \
            ${LAYERDIR}/recipes-*/*/*.bbappend"

BBFILE_COLLECTIONS += "hmi"
BBFILE_PATTERN_hmi = "^${LAYERDIR}/"
BBFILE_PRIORITY_hmi = "8"

LAYERSERIES_COMPAT_hmi = "walnascar"

# Optionally, add this if your layer uses dynamic layers
# LAYERDEPENDS_hmi = "core"
```
